## firmware/common/components/ble_provisioning/Kconfig
```kconfig
menu "Device BLE provisioning"

    config DEVICE_PROV_POP
        string "Security 1 proof of possession"
        help
            The production build must inject a unique value for every device.
            An empty value is rejected at compile time.

    config DEVICE_MQTT_URI
        string "Default MQTT broker URI"
        default ""
        help
            Required factory MQTT broker URI, including the mqtts:// scheme and
            port. Inject it through the per-device build configuration.

    config DEVICE_MQTT_USERNAME
        string "Default MQTT device username"
        default ""
        help
            Required factory device username. Store device-specific credentials
            in the untracked sdkconfig file, not in sdkconfig.defaults.

    config DEVICE_MQTT_PASSWORD
        string "Default MQTT device password"
        default ""
        help
            Required factory device password. This value is embedded in the
            firmware image; use a unique, topic-restricted device account.

    config DEVICE_PROV_RESET_GPIO
        int "Provisioning reset GPIO"
        range 0 21
        default 9

    config DEVICE_PROV_RESET_HOLD_MS
        int "Reset button hold time (ms)"
        range 1000 30000
        default 5000

endmenu
```

## firmware/main/main/Kconfig.projbuild
```kconfig
menu "Motor node hardware"

config MOTOR_STEP_GPIO
    int "STEP GPIO"
    range 0 21
    default 0

config MOTOR_DIR_GPIO
    int "DIR GPIO"
    range 0 21
    default 1

config MOTOR_FULL_STEPS_PER_REV
    int "Motor full steps per revolution"
    range 1 100000
    default 200

config MOTOR_MICROSTEP
    int "Driver microstep divisor"
    range 1 256
    default 8

config MOTOR_DEFAULT_RPM
    int "Default motor RPM"
    range 1 1000
    default 100

config MOTOR_MAX_RPM
    int "Maximum motor RPM"
    range 1 1000
    default 150

config MOTOR_ACCELERATION
    int "Acceleration in pulses per second squared"
    range 1 1000000
    default 1000

config MOTOR_DIRECTION_INVERTED
    bool "Invert electrical motor direction"
    default n

config MOTOR_FULL_TRAVEL_STEPS
    int "Pulses from fully closed to fully open"
    range 1 2147483647
    default 36000
    help
        Replace the default with the measured pulse count after installing the
        actuator. This is not the motor's steps-per-revolution value.

config MOTOR_VENTILATION_POSITION_100THS
    int "Ventilation position in 0.01 percent units"
    range 0 10000
    default 2500

config MOTOR_FEEDBACK_STALE_MS
    int "Position feedback timeout in milliseconds"
    range 100 10000
    default 2000

config MOTOR_FEEDBACK_PERIOD_MS
    int "Position feedback period in milliseconds"
    range 5 500
    default 20
endmenu
```

## firmware/main/sdkconfig.defaults
```kconfig
CONFIG_ESPTOOLPY_FLASHSIZE_4MB=y
CONFIG_PARTITION_TABLE_CUSTOM=y
CONFIG_PARTITION_TABLE_CUSTOM_FILENAME="partitions_4mb_optimised.csv"
CONFIG_PARTITION_TABLE_OFFSET=0xc000
CONFIG_MBEDTLS_DYNAMIC_BUFFER=y
CONFIG_MBEDTLS_DYNAMIC_FREE_CONFIG_DATA=y
CONFIG_MBEDTLS_CERTIFICATE_BUNDLE_DEFAULT_CMN=y
CONFIG_BT_ENABLED=y
CONFIG_BT_NIMBLE_ENABLED=y
# CONFIG_BT_BLUEDROID_ENABLED is not set
CONFIG_ESP_PROTOCOMM_SUPPORT_SECURITY_VERSION_1=y
# CONFIG_ESP_PROTOCOMM_SUPPORT_SECURITY_VERSION_2 is not set
CONFIG_NETWORK_PROV_NETWORK_TYPE_WIFI=y
CONFIG_MQTT_PROTOCOL_5=y
CONFIG_MOTOR_FULL_STEPS_PER_REV=200
CONFIG_MOTOR_MICROSTEP=8
CONFIG_MOTOR_DEFAULT_RPM=100
CONFIG_MOTOR_MAX_RPM=150
CONFIG_MOTOR_ACCELERATION=1000
CONFIG_MOTOR_FULL_TRAVEL_STEPS=36000
CONFIG_MOTOR_FEEDBACK_MODE_PULSE_ONLY=y
# CONFIG_BOOTLOADER_APP_ROLLBACK_ENABLE is not set
CONFIG_ESP_COREDUMP_ENABLE_TO_FLASH=y
CONFIG_ESP_COREDUMP_CHECK_BOOT=y
CONFIG_ESP_COREDUMP_MAX_TASKS_NUM=32
# CONFIG_ESP_COREDUMP_CAPTURE_DRAM is not set
```

## firmware/sensor/sdkconfig.defaults
```kconfig
CONFIG_ESPTOOLPY_FLASHSIZE_4MB=y
CONFIG_PARTITION_TABLE_CUSTOM=y
CONFIG_PARTITION_TABLE_CUSTOM_FILENAME="partitions_4mb_optimised.csv"
CONFIG_PARTITION_TABLE_OFFSET=0xc000
CONFIG_MBEDTLS_DYNAMIC_BUFFER=y
CONFIG_MBEDTLS_DYNAMIC_FREE_CONFIG_DATA=y
CONFIG_MBEDTLS_CERTIFICATE_BUNDLE_DEFAULT_CMN=y
CONFIG_BT_ENABLED=y
CONFIG_BT_NIMBLE_ENABLED=y
# CONFIG_BT_BLUEDROID_ENABLED is not set
CONFIG_ESP_PROTOCOMM_SUPPORT_SECURITY_VERSION_1=y
# CONFIG_ESP_PROTOCOMM_SUPPORT_SECURITY_VERSION_2 is not set
CONFIG_NETWORK_PROV_NETWORK_TYPE_WIFI=y
CONFIG_MQTT_PROTOCOL_5=y
# CONFIG_BOOTLOADER_APP_ROLLBACK_ENABLE is not set
CONFIG_ESP_COREDUMP_ENABLE_TO_FLASH=y
CONFIG_ESP_COREDUMP_CHECK_BOOT=y
CONFIG_ESP_COREDUMP_MAX_TASKS_NUM=32
# CONFIG_ESP_COREDUMP_CAPTURE_DRAM is not set
```
